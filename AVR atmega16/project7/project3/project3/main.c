/***********************************************************************
    Подключение библиотек
************************************************************************/
#include <avr/io.h>
//#include <avr/iom16.h> //Библитотека с описанием названий регистров и разрядов регистров
//Если среда разработки формирует макроопределение целевого микроконтроллера,
//то отдельно подключать не нужно
#include <avr/interrupt.h> //Библиотека для работы с прерываниями

/***********************************************************************
    Глобальные переменные
************************************************************************/
unsigned char buf[8];
unsigned char temp = 0;
unsigned char counter_rx = 0;
unsigned char counter_tx = 0;
unsigned char counter_buf = 0;

/***********************************************************************
    Прототипы функций
************************************************************************/
void InitUSART(void);           // Инициализация модуля USART

/***********************************************************************
Главная программа
************************************************************************/
int main(void)
{   
    //Инициализация необходимых периферийных модулей
    InitUSART();    //Инициализация модуля USART
	                         
    //UCSRB &= ~(1<<TXEN);
    UCSRB |= (1<<RXEN);
	UCSRB &= ~(1<<TXEN);             
    while(1)
    {
        if(UCSRA & (1<<RXC))
        {
			UCSRB &= ~(1<<RXEN);    // Запрет приёма
            temp = UDR;
            buf[counter_buf] = temp;
            counter_buf = (counter_buf + 1) & 0x07;
            counter_rx++;
			UCSRB |= (1<<RXEN);    // Разрешение приёма
        }
        if(counter_rx != counter_tx)
        {
            if(UCSRA & (1<<UDRE))
            {
				UCSRB &= ~(1<<RXEN);    // Запрет приёма
				UCSRB |= (1<<TXEN);     // Разрешение передачи
                counter_buf = (counter_buf - 1) & 0x07;
				temp = buf[counter_buf];
				UDR = temp;
                counter_tx++;
				while(UCSRA & (1<<TXC) == 0) {}
				UCSRB &= ~(1<<TXEN);    // Запрет передачи
				UCSRB |= (1<<RXEN);     // Разрешение приёма
            }
        }
    }       
}

/*********************************************************************** 
    Инициализация модуля USART:
    скорость обмена 19200 бод, 8 бит данных, 1 стоп-бит, бит паритета - нет
************************************************************************/
void InitUSART(void)
{
    
    UBRRL = 0x1D;                               // Установка скорости обмена
    UBRRH = 0x00;                               // UBRR = 9216000/(16*BOD)-1
    UCSRC = (1<<URSEL)|(1<<UCSZ0)|(1<<UCSZ1);   // Формат кадра - 8 бит данных, без бита паритета
}
